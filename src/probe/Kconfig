## src/probe/Kconfig
```kconfig
# SPDX-License-Identifier: BSD-3-Clause

# Probe configs

menu "Probe"

config PROBE
	bool "Probes enabled"
	default n
	help
	  Select for enabling debug probes to extract/inject buffers

endmenu
```

## zephyr/Kconfig
```kconfig
if SOF
rsource "../Kconfig.sof"

config SOF_ZEPHYR_HEAP_CACHED
	bool "Cached Zephyr heap for SOF memory non-shared zones"
	default y if CAVS
	default n
	help
	  Enable cached heap by mapping cached SOF memory zones to different
	  Zephyr sys_heap objects and enable caching for non-shared zones.

config ZEPHYR_NATIVE_DRIVERS
	bool "Use Zephyr native drivers"
	default n
	help
	  Enable Zephyr native drivers for host and dai components

endif
```
